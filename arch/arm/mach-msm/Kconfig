## arch/arm/mach-msm/huawei/Kconfig.board
```kconfig
config MACH_HUAWEI_U8800
	depends on ARCH_MSM7X30
	depends on !MSM_STACKED_MEMORY
	select MACH_HUAWEI
	select MSM_HUAWEI_HWPROPS
	select MSM_HUAWEI_RMT_OEMINFO
	bool "HUAWEI U8800"
	help
	  Support for the Huawei U8800 board.

config MACH_HUAWEI_U8800PRO
	depends on ARCH_MSM7X30
	depends on !MSM_STACKED_MEMORY
	select MACH_HUAWEI
	select MSM_HUAWEI_HWPROPS
	select MSM_HUAWEI_RMT_OEMINFO
	bool "HUAWEI U8800PRO"
	help
	  Support for the Huawei U8800PRO board.

config MACH_HUAWEI_U8860
	depends on ARCH_MSM7X30
	depends on !MSM_STACKED_MEMORY
	select MACH_HUAWEI
	select MSM_HUAWEI_HWPROPS
	select MSM_HUAWEI_RMT_OEMINFO
	bool "HUAWEI U8860"
	help
	  Support for the Huawei U8860 board.

config MACH_HUAWEI_U8860LP
	depends on ARCH_MSM7X30
	depends on !MSM_STACKED_MEMORY
	select MACH_HUAWEI
	select MSM_HUAWEI_HWPROPS
	select MSM_HUAWEI_RMT_OEMINFO
	bool "HUAWEI U8860LP"
	help
	  Support for the Huawei U8860LP board.

config MACH_HUAWEI_U8860_51
	depends on ARCH_MSM7X30
	depends on !MSM_STACKED_MEMORY
	select MACH_HUAWEI
	select MSM_HUAWEI_HWPROPS
	select MSM_HUAWEI_RMT_OEMINFO
	bool "HUAWEI U8860-51"
	help
	  Support for the Huawei U8860-51 board.

config MACH_HUAWEI_U8860_92
	depends on ARCH_MSM7X30
	depends on !MSM_STACKED_MEMORY
	select MACH_HUAWEI
	select MSM_HUAWEI_HWPROPS
	select MSM_HUAWEI_RMT_OEMINFO
	bool "HUAWEI U8860-92"
	help
	  Support for the Huawei U8860-92 board.

config MACH_HUAWEI_U8860_R
	depends on ARCH_MSM7X30
	depends on !MSM_STACKED_MEMORY
	select MACH_HUAWEI
	select MSM_HUAWEI_HWPROPS
	select MSM_HUAWEI_RMT_OEMINFO
	bool "HUAWEI U8860-R"
	help
	  Support for the Huawei U8860-R board.

config MACH_HUAWEI_C8860
	depends on ARCH_MSM7X30
	depends on !MSM_STACKED_MEMORY
	select MACH_HUAWEI
	select MSM_HUAWEI_HWPROPS
	select MSM_HUAWEI_RMT_OEMINFO
	bool "HUAWEI C8860"
	help
	  Support for the Huawei C8860 board.
```

## arch/arm/mach-msm/semc/Kconfig
```kconfig
config MACH_SEMC
	bool

config BATTERY_SEMC_ARCH
	bool "SEMC battery data handling"
	depends on ARCH_MSM
	default n
	help
	  Say Y to enable support for SEMC battery data handling in the
	  platform.

config SEMC_BATTERY_SHOW_HEALTH
	bool "Enable battery health support"
	depends on BATTERY_SEMC_ARCH
	default n if BATTERY_CHARGALG
	default y if !BATTERY_CHARGALG
	help
	  Enable if battery health property is not supported
	  in any other module besides this.
	  This enables support for power supply class
	  POWER_SUPPLY_PROP_HEALTH property.

config SEMC_CHARGER_USB_ARCH
	bool "Support USB interface for charger"
	default n
	help
	  This enables USB interface for charger.

config SEMC_RPC_SERVER_HANDSET
	bool "Enable SEMC handset rpc dispatcher"
	depends on ARCH_MSM7X30 && MSM_ONCRPCROUTER && !MSM_RPCSERVER_HANDSET
	default y
	help
	 This enables the SEMC version of rpc_server_handset message dispatcher.
	 This cannot cooperate with MSM_RPCSERVER_HANDSET. If this is set,
	 an error will be generated.
```

## arch/arm/mach-msm/semc/Kconfig.board
```kconfig
config BOARD_SEMC_MOGAMI
	depends on ARCH_MSM7X30
	depends on !MSM_STACKED_MEMORY
	select MACH_SEMC
	default n
	bool "SonyEricsson Mogami Platform"
	help
	  Support for the SonyEricsson mogami platform.

config BOARD_SEMC_ZEUS
	depends on ARCH_MSM7X30
	depends on !MSM_STACKED_MEMORY
	select MACH_SEMC
	default n
	bool "SonyEricsson Zeus Platform"
	help
	  Support for the SonyEricsson zeus platform.

config MACH_SEMC_ANZU
	depends on BOARD_SEMC_MOGAMI
	default n
	bool "SonyEricsson Anzu"
	help
	  Support for the SonyEricsson Anzu devices.

config MACH_SEMC_COCONUT
	depends on BOARD_SEMC_MOGAMI
	default n
	bool "SonyEricsson Coconut"
	help
	  Support for the SonyEricsson Coconut devices.

config MACH_SEMC_HAIDA
	depends on BOARD_SEMC_MOGAMI
	default n
	bool "SonyEricsson Haida"
	help
	  Support for the SonyEricsson Haida devices.

config MACH_SEMC_HALLON
	depends on BOARD_SEMC_MOGAMI
	default n
	bool "SonyEricsson Hallon"
	help
	  Support for the SonyEricsson Hallon devices.

config MACH_SEMC_IYOKAN
	depends on BOARD_SEMC_MOGAMI
	default n
	bool "SonyEricsson Iyokan"
	help
	  Support for the SonyEricsson Iyokan devices.

config MACH_SEMC_MANGO
	depends on BOARD_SEMC_MOGAMI
	default n
	bool "SonyEricsson Mango"
	help
	  Support for the SonyEricsson Mango devices.

config MACH_SEMC_SATSUMA
	depends on BOARD_SEMC_MOGAMI
	default n
	bool "SonyEricsson Satsuma"
	help
	  Support for the SonyEricsson Satsuma devices.

config MACH_SEMC_SMULTRON
	depends on BOARD_SEMC_MOGAMI
	default n
	bool "SonyEricsson Smultron"
	help
	  Support for the SonyEricsson Smultron devices.

config MACH_SEMC_URUSHI
	depends on BOARD_SEMC_MOGAMI
	default n
	bool "SonyEricsson Urushi"
	help
	  Support for the SonyEricsson Urushi devices.

config MACH_SEMC_ZEUS
	depends on BOARD_SEMC_ZEUS
	default n
	bool "SonyEricsson Zeus"
	help
	  Support for the SonyEricsson Zeus devices.

config MACH_SEMC_PHOENIX
	depends on BOARD_SEMC_ZEUS
	default n
	bool "SonyEricsson Phoenix"
	help
	  Support for the SonyEricsson Phoenix devices.
```

## drivers/video/msm/Kconfig
```kconfig
source "drivers/video/msm/vidc/Kconfig"

config FB_MSM
	tristate "MSM Framebuffer support"
	depends on FB && ARCH_MSM
	select FB_BACKLIGHT if FB_MSM_BACKLIGHT
	select NEW_LEDS
	select LEDS_CLASS
	select FB_CFB_FILLRECT
	select FB_CFB_COPYAREA
	select FB_CFB_IMAGEBLIT
	---help---
	  Support for MSM Framebuffer.

if FB_MSM

config FB_MSM_BACKLIGHT
	bool "Support for backlight control"
	default y
	---help---
	  Say Y here if you want to control the backlight of your display.

config FB_MSM_LOGO
	bool "MSM Frame Buffer Logo"
	default n
	---help---
	  Show /initlogo.rle during boot.

config FB_MSM_LCDC_HW
	bool
	default n

config FB_MSM_TRIPLE_BUFFER
	bool "Support for triple frame buffer"
	default n

config FB_MSM_MDP_HW
	bool
	default n

choice
	prompt "MDP HW version"
	default FB_MSM_MDP40

config FB_MSM_MDP40
	select FB_MSM_LCDC_HW
	select FB_MSM_MDP_HW
	bool "MDP HW ver4.0"
	---help---
	  Support for MSM MDP HW revision 4.0
	  Say Y here if this is msm7x30 variant platform.

config FB_MSM_MDP_NONE
	bool "MDP HW None"
	---help---
	  Say Y here if this is mdm platform.

endchoice

config FB_MSM_MDDI
	bool
	default n

config FB_MSM_LCDC
	bool
	default n

config FB_MSM_OVERLAY
	depends on FB_MSM_MDP40
	bool "MDP4 overlay support"
	default n

config FB_MSM_DTV
	depends on FB_MSM_OVERLAY
	bool
	default n

config FB_MSM_TVOUT
	bool
	default n

config FB_MSM_MDDI_NOVATEK_FWVGA
	bool
	select FB_MSM_MDDI
	default n

config FB_MSM_MDDI_AUTO_DETECT
	bool
	select FB_MSM_MDDI
	default n

config FB_MSM_MDDI_DISABLE_REVERSE
	bool "DISABLE REVERSE"
	default n

config FB_MSM_LCDC_AUTO_DETECT
	bool
	select FB_MSM_LCDC
	default n

config FB_MSM_LCDC_PANEL
	bool
	select FB_MSM_LCDC
	default n

config FB_MSM_NO_MDP_PIPE_CTRL
	depends on FB_MSM_OVERLAY
	bool "Do not use mdp_pipe_ctrl"
	---help---
	  Saying 'Y' here obsoletes the mdp_pipe_ctrl function,
	  which was used to control mdp-related clocks. MDP4 vsync-driven
	  screen updates will use a different clock control mechanism if
	  this is selected.

config FB_MSM_OVERLAY0_WRITEBACK
	depends on FB_MSM_OVERLAY
        bool "MDP overlay0 write back mode enable"
	---help---
	  Support for MDP4 OVERLAY0 write back mode


config FB_MSM_OVERLAY1_WRITEBACK
        depends on FB_MSM_OVERLAY
        bool "MDP overlay1 write back mode enable"
        ---help---
          Support for MDP4 OVERLAY1 write back mode

config FB_MSM_WRITEBACK_MSM_PANEL
	depends on FB_MSM_OVERLAY
        bool "MDP overlay write back panel enable"
	---help---
	  Support for MDP4 OVERLAY write back mode

menu "LCD Panel"

config FB_MSM_MDDI_PANEL_AUTO_DETECT
	bool "MDDI Panel Auto Detect"
	select FB_MSM_MDDI_AUTO_DETECT
	---help---
	  Support for MDDI panel auto detect.
	  This also enables MDDI reverse link.

config FB_MSM_LCDC_PANEL_AUTO_DETECT
	bool "LCDC Panel Auto Detect"
	---help---
	  Support for LCDC panel auto detect

config FB_MSM_LCDC_MIPI_PANEL_AUTO_DETECT
	bool "LCDC + MIPI Panel Auto Detect"
	---help---
	  Support for LCDC + MIPI panel auto detect

config FB_MSM_MDDI_SONY_HVGA
	bool "MDDI Sony HVGA Panel"
	select FB_MSM_MDDI
	---help---
	  Support for MDDI Sony HVGA (320x480) panel

config FB_MSM_MDDI_HITACHI_HVGA
	bool "MDDI Hitachi HVGA Panel"
	select FB_MSM_MDDI
	---help---
	  Support for MDDI Hitachi HVGA (320x480) panel

config FB_MSM_MDDI_SII_HVGA
	bool "MDDI Sii HVGA Panel"
	select FB_MSM_MDDI
	default n
	---help---
	  Support for MDDI Sii HVGA (320x480) panel

config FB_MSM_MDDI_AUO_HVGA
	bool "MDDI Auo HVGA Panel"
	select FB_MSM_MDDI
	default n
	---help---
	  Support for MDDI Auo HVGA (320x480) panel

config FB_MSM_MDDI_NOVATEK_TMD_MDP42
	bool "TMD MDP42 Panel"
	select FB_MSM_MDDI_NOVATEK_FWVGA
	default n
	---help---
	  Support for TMD MDP42 panel connected
	  to the MDDI Novatek micro controller

config FB_MSM_MDDI_NOVATEK_SHARP_LS040T8LX01
	bool "SHARP LS040T8LX01 Panel"
	select FB_MSM_MDDI_NOVATEK_FWVGA
	default n
	---help---
	  Support for SHARP LS040T8LX01 panel connected
	  to the MDDI Novatek micro controller

config FB_MSM_MDDI_NOVATEK_SHARP_LS042T3LX
	bool "SHARP LS042T3LX Panel"
	select FB_MSM_MDDI_NOVATEK_FWVGA
	default n
	---help---
	  Support for SHARP_LS042T3LX panel connected
	  to the MDDI Novatek micro controller

config FB_MSM_MDDI_NOVATEK_SONY_ACX424AKM
	bool "SONY ACX424AKM Panel"
	select FB_MSM_MDDI_NOVATEK_FWVGA
	default n
	---help---
	  Support for SONY_ACX424AKM panel connected
	  to the MDDI Novatek micro controller

config FB_MSM_MDDI_NOVATEK_SONY_ACX427AK
	bool "SONY ACX427AK Panel"
	select FB_MSM_MDDI_NOVATEK_FWVGA
	default n
	---help---
	  Support for SONY_ACX427AK panel connected
	  to the MDDI Novatek micro controller

config FB_MSM_MDDI_NOVATEK_SONY_ACX424AK
	bool "SONY ACX424AK Panel"
	select FB_MSM_MDDI_NOVATEK_FWVGA
	default n
	---help---
	  Support for SONY_ACX424AK panel connected
	  to the MDDI Novatek micro controller

config FB_MSM_MDDI_NOVATEK_HITACHI_DX09D09VM
	bool "HITACHI DX09D09VM Panel"
	select FB_MSM_MDDI_NOVATEK_FWVGA
	default n
	---help---
	  Support for HITACHI_DX09D09VM panel connected
	  to the MDDI Novatek micro controller

config FB_MSM_MDDI_NOVATEK_SHARP_LS033T3LX01
	bool "SHARP LS033T3LX01 Panel"
	select FB_MSM_MDDI_NOVATEK_FWVGA
	default n
	---help---
	  Support for SHARP_LS033T3LX01 panel connected
	  to the MDDI Novatek micro controller

config FB_MSM_MDDI_NOVATEK_TMD_LT033MDV1000
	bool "TMD LT033MDV1000 Panel"
	select FB_MSM_MDDI_NOVATEK_FWVGA
	default n
	---help---
	  Support for TMD_LT033MDV1000 panel connected
	  to the MDDI Novatek micro controller

config FB_MSM_MDDI_NT35560_FWVGA
	bool "MDDI NT35560 FWVGA panel"
	select FB_MSM_MDDI
	---help---
	  Support for MDDI NT35560 (480x854) FWVGA panel

config FB_MSM_MDDI_NT35582_WVGA
	bool "MDDI NT35582 WVGA panel"
	select FB_MSM_MDDI
	---help---
	  Support for MDDI NT35582 (480x800) WVGA panel

config FB_MSM_HDMI_AS_PRIMARY
	depends on FB_MSM_HDMI_COMMON
	bool "Use HDMI as primary panel"
	---help---
	Support for using HDMI as primary

config FB_MSM_PANEL_NONE
	bool "NONE"
	---help---
	  This will disable LCD panel
endmenu

config FB_MSM_EXT_INTERFACE_COMMON
	bool
	default n

config FB_MSM_HDMI_COMMON
	bool
	default n

config FB_MSM_HDMI_3D
	bool
	default n

config FB_MSM_HDMI_ADV7520_PANEL
	depends on FB_MSM_MDP40 && FB_MSM_OVERLAY
        bool "LCDC HDMI ADV7520 720p Panel"
        select FB_MSM_DTV
        select FB_MSM_EXT_INTERFACE_COMMON
	select FB_MSM_HDMI_COMMON
	default n
        ---help---
        Support for LCDC 720p HDMI panel attached to ADV7520

config FB_MSM_HDMI_ADV7520_PANEL_HDCP_SUPPORT
        depends on FB_MSM_HDMI_ADV7520_PANEL
        bool "Use HDCP mode"
        default y
        ---help---
          Support for HDCP mode for ADV7520 HDMI 720p Panel
          Choose to enable HDCP


config FB_MSM_HDMI_MSM_PANEL
	depends on FB_MSM_MDP40
	bool "MSM HDMI 1080p Panel"
	select FB_MSM_DTV
        select FB_MSM_EXT_INTERFACE_COMMON
	select FB_MSM_HDMI_COMMON
	select FB_MSM_HDMI_3D
	default n
	---help---
	  Support for 480p/720p/1080i/1080p output through MSM HDMI

config FB_MSM_HDMI_MSM_PANEL_DVI_SUPPORT
	depends on FB_MSM_HDMI_MSM_PANEL
	bool "Use DVI mode"
	default n
	---help---
	  Support for DVI mode for MSM HDMI 1080p Panel

config FB_MSM_HDMI_MSM_PANEL_CEC_SUPPORT
	depends on FB_MSM_HDMI_MSM_PANEL
	bool "Enable CEC"
	default n
	---help---
	  Support for HDMI CEC Feature
	  Choose to enable CEC

choice
	depends on FB_MSM_MDP40
	prompt "TVOut Region"
	default FB_MSM_TVOUT_NONE

config FB_MSM_TVOUT_NTSC_M
	bool "NTSC M"
	select FB_MSM_TVOUT
        select FB_MSM_EXT_INTERFACE_COMMON
	---help---
	  Support for NTSC M region (North American and Korea)

config FB_MSM_TVOUT_NTSC_J
	bool "NTSC J"
	select FB_MSM_TVOUT
        select FB_MSM_EXT_INTERFACE_COMMON
	---help---
	  Support for NTSC J region (Japan)

config FB_MSM_TVOUT_PAL_BDGHIN
	bool "PAL BDGHIN"
	select FB_MSM_TVOUT
        select FB_MSM_EXT_INTERFACE_COMMON
	---help---
	  Support for PAL BDGHIN region (Non-argentina PAL-N)

config FB_MSM_TVOUT_PAL_M
	bool "PAL M"
	select FB_MSM_TVOUT
        select FB_MSM_EXT_INTERFACE_COMMON
	---help---
	  Support for PAL M region

config FB_MSM_TVOUT_PAL_N
	bool "PAL N"
	select FB_MSM_TVOUT
        select FB_MSM_EXT_INTERFACE_COMMON
	---help---
	  Support for PAL N region (Argentina PAL-N)

config FB_MSM_TVOUT_NONE
	bool "NONE"
	---help---
	  This will disable TV Out functionality.
endchoice

config FB_MSM_TVOUT_SVIDEO
	bool "TVOut on S-video"
	depends on FB_MSM_TVOUT
	default n
	---help---
	  Selects whether the TVOut signal uses S-video.
	  Choose n for composite output.

choice
	prompt "Default framebuffer color depth"
	depends on FB_MSM_MDP40
	default FB_MSM_DEFAULT_DEPTH_RGBA8888

config FB_MSM_DEFAULT_DEPTH_RGB565
	bool "16 bits per pixel (RGB565)"

config FB_MSM_DEFAULT_DEPTH_ARGB8888
	bool "32 bits per pixel (ARGB8888)"

config FB_MSM_DEFAULT_DEPTH_RGBA8888
	bool "32 bits per pixel (RGBA8888)"

endchoice

endif
```

## sound/soc/msm/Kconfig
```kconfig
menu "MSM SoC Audio support"

#7630 Variants
config SND_MSM7KV2_DAI_SOC
	tristate

config SND_MSM_SOC_MSM7KV2
	tristate

config SND_MSM7KV2_SOC
	tristate "SoC Audio for the MSM7KV2 chip"
	depends on ARCH_MSM7X30 && SND_SOC && MSM7KV2_AUDIO
	select SND_MSM_SOC_MSM7KV2
	select SND_MSM7KV2_DAI_SOC
	default n
	help
	  To add support for ALSA PCM driver for QSD8k board.

config SND_MSM_MVS7x30_SOC
	tristate

config SND_MSM_MVS_DAI_SOC
	tristate

config SND_MVS_SOC
	tristate "SoC Mvs support for MSM7X30"
	depends on SND_MSM7KV2_SOC
	select SND_MSM_MVS7x30_SOC
	select SND_MSM_MVS_DAI_SOC
	default n
	help
	  To support Mvs packet capture/playback

endmenu
```
